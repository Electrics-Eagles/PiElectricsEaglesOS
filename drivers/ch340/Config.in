## drivers/ch340/Config.in
```kconfig
config BR2_PACKAGE_CH340
    bool "cH340"
    depends on BR2_LINUX_KERNEL
    help
      It is CH340 driver
      https://github.com/juliagoda/CH341SER
    
```

## drivers/rtl8153/Config.in
```kconfig
config BR2_PACKAGE_RTL8153
    bool "RTL8153"
    depends on BR2_LINUX_KERNEL
    help
      It is RTL8153 Linksys driver
      https://github.com/rickhofstede/linksys_usb3gigv1_linux
    
```
